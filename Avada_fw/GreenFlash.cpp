/*
 * GreenFlash.cpp
 *
 *  Created on: 12 апр. 2022 г.
 *      Author: layst
 */

#include "GreenFlash.h"
#include "Settings.h"
#include "buzzer.h"
#include "kl_lib.h"
#include "adcF072.h"
#include "shell.h"
#include "MsgQ.h"
#include "EvtMsgIDs.h"

static TmrKL_t ITmr {999, evtIdDelayEnd, tktOneShot}; // Delay is dummy
enum class Sta {
    Charging, IgnoringBtn, WaitingBtn, WaitingFlash, Flash, WaitingRestart
} State = Sta::Charging;

void Fire() {
    State = Sta::Flash;
    Buzzer.Off();
    PinSetHi(GREEN_LED);
    ITmr.StartOrRestart(TIME_MS2I(Settings.FlashDurtn_ms));
}

void EnterWaitingRestart() {
    State = Sta::WaitingRestart;
    PinSetLo(GREEN_LED); // Needed after flash
    Buzzer.SetVolume(Settings.WaitingRestart.Volume);
    Buzzer.BeWaitingRestart();
    // Start DelayBeforeRestart timeout. Will end immediately if 0.
    ITmr.StartOrRestart(TIME_S2I(Settings.WaitingRestart.Duration));
}

void EnterWaitingFlash() {
    State = Sta::WaitingFlash;
    Buzzer.SetVolume(Settings.WaitingFlash.Volume);
    Buzzer.BeReady();
    // Start BeforeFlash timeout. Will end immediately if 0.
    ITmr.StartOrRestart(TIME_S2I(Settings.WaitingFlash.Duration));
}

void EnterWaitingBtn() {
    State = Sta::WaitingBtn;
    Buzzer.SetVolume(Settings.WaitingBtn.Volume);
    Buzzer.BeReady();
    // Start timeout if not 0. If 0 - do not start and wait forever.
    if(Settings.WaitingBtn.Duration == 0) ITmr.Stop();
    else ITmr.StartOrRestart(TIME_S2I(Settings.WaitingBtn.Duration));
}

void EnterIgnoringBtn() {
    State = Sta::IgnoringBtn;
    Buzzer.SetVolume(Settings.IgnoringBtn.Volume);
    Buzzer.BeReady();
    // Will fire immeditely if delay is zero
    ITmr.StartOrRestart(TIME_S2I(Settings.IgnoringBtn.Duration));
}

void EnterCharging() {
    if(Settings.Charging.Duration == 0) EnterIgnoringBtn();
    else {
        State = Sta::Charging;
        ITmr.Stop(); // End event will be generated by buzzer
        Buzzer.SetVolume(Settings.Charging.Volume);
        Buzzer.BuzzUp(Settings.Charging.Duration);
    }
}

namespace GreenFlash {

void Init() {
    PinSetupOut(GREEN_LED, omPushPull, psHigh);
    EnterCharging();
}

void OnDelayEnd() {
    switch(State) {
        case Sta::Charging:       EnterIgnoringBtn(); break; // End event generated by buzzer, not timer, but who cares
        case Sta::IgnoringBtn:    EnterWaitingBtn(); break;
        case Sta::WaitingBtn:     EnterWaitingRestart(); break; // NotFired timeout occured
        case Sta::WaitingRestart: EnterCharging(); break;  // Delay ended
        case Sta::WaitingFlash:   Fire(); break; // Time to fire
        case Sta::Flash:          EnterWaitingRestart(); break;
    } // switch
}

void OnBtnPress() {
    if(State == Sta::WaitingBtn) EnterWaitingFlash();
}

} // namespace
